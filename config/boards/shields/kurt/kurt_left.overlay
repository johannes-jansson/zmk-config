#include "kurt.dtsi"

&kscan0 {
    col-gpios
        = <&pro_micro 2 GPIO_ACTIVE_HIGH> // col1 in the schematic
        , <&pro_micro 3 GPIO_ACTIVE_HIGH> // col2 in the schematic
        , <&pro_micro 4 GPIO_ACTIVE_HIGH> // col3 in the schematic
        , <&pro_micro 5 GPIO_ACTIVE_HIGH> // col4 in the schematic
        , <&pro_micro 6 GPIO_ACTIVE_HIGH> // col5 in the schematic
        , <&pro_micro 7 GPIO_ACTIVE_HIGH> // col6 in the schematic
        ;
};
