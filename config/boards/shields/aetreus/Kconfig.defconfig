## config/boards/shields/kurt/Kconfig.defconfig
```kconfig
if SHIELD_KURT_LEFT

config ZMK_KEYBOARD_NAME
    default "Kurt"

config ZMK_SPLIT_ROLE_CENTRAL
    default y

endif

if SHIELD_KURT_LEFT || SHIELD_RIGHT_RIGHT

config ZMK_SPLIT
    default y

endif
```

## config/boards/shields/kurt/Kconfig.shield
```kconfig
config SHIELD_KURT_LEFT
    def_bool $(shields_list_contains,kurt_left)

config SHIELD_KURT_RIGHT
    def_bool $(shields_list_contains,kurt_right)
```
